## conf/layer.conf
```bitbake
# We have a conf and classes directory, add to BBPATH
BBPATH .= ":${LAYERDIR}"

# We have recipes-* directories, add to BBFILES
BBFILES += "${LAYERDIR}/recipes-*/*/*.bb \
            ${LAYERDIR}/recipes-*/*/*.bbappend"

BBFILE_COLLECTIONS += "meta-varun"
BBFILE_PATTERN_meta-varun = "^${LAYERDIR}/"
BBFILE_PRIORITY_meta-varun = "6"

LAYERDEPENDS_meta-varun = "core"
LAYERSERIES_COMPAT_meta-varun = "scarthgap"

KERNEL_DEVICETREE:append = " overlays/my-ssd1306.dtbo"
```
